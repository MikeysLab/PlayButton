#include <Adafruit_NeoPixel.h>
#include <Wire.h>
#include <Adafruit_SSD1306.h>
#include <gfxfont.h>
#include <Adafruit_GFX.h>
#include <WiFiClientSecure.h>
#include <ESP8266WiFi.h>


#define OLED_RESET LED_BUILTIN
#define SSD1306_I2C_ADDRESS 0x3C

#define STRIP_BRIGHTNESS 50
#define NUM_PIXELS 24
#define STRIP_PIN D3

Adafruit_SSD1306 display(OLED_RESET);
Adafruit_NeoPixel strip = Adafruit_NeoPixel(NUM_PIXELS, STRIP_PIN, NEO_GRB + NEO_KHZ800);

const unsigned char logo[] = {
	0xFF, 0xFF, 0xFF, 0xFF, 0xFF, 0xFF, 0xFF, 0xFF, 0xFF, 0xFF, 0xFF, 0xFF, 0xFF, 0xFF, 0xFF, 0xFF,
	0xFF, 0xFF, 0xFF, 0xFF, 0xFF, 0xFF, 0xFF, 0xFF, 0xFF, 0xFF, 0xFF, 0xFF, 0xFF, 0xFF, 0xFF, 0xFF,
	0xFF, 0xFF, 0xFF, 0xFF, 0xFF, 0xFF, 0xFF, 0xFF, 0xFF, 0xFF, 0xFF, 0xFF, 0xFF, 0xFF, 0xFF, 0xFF,
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	0xFF, 0xFF, 0xFF, 0xFF, 0xFF, 0xFF, 0xFF, 0xFF, 0xFF, 0xFF, 0xFF, 0xFF, 0xFF, 0xFF, 0xFF, 0xFF
};

const char* host = "www.googleapis.com";
const int httpsPort = 443;
const char* fingerprint = "6F:B4:5F:41:2F:7D:9F:BA:67:40:03:08:61:76:A5:32:FF:A6:8C:DA";

const char* ssid = "<YourSSID>";
const char* password = "<yourPassword>";

int curSubs = 0;
int curViews = 0;

int nextUpdateMS = 0;
int updateDelayMS = 2000;


void setup() 
{
	Serial.begin(115200);
	SetupDisplay();
	SetupStrip();
	SetupWiFi();
}

void SetupStrip()
{
	strip.begin();
	strip.setBrightness(STRIP_BRIGHTNESS);
	whiteStrip();
}

void SetupDisplay()
{
	display.begin(SSD1306_SWITCHCAPVCC, SSD1306_I2C_ADDRESS);
	showLogo();
}

void showLogo()
{
	display.clearDisplay();
	display.display();
	display.drawBitmap(0, 0, logo, 128, 64, WHITE);
	display.display();
}

void SetupWiFi()
{
	WiFi.mode(WIFI_STA);
	WiFi.begin(ssid, password);

	while (WiFi.status() != WL_CONNECTED) 
	{
		delay(500);
		colorWipe(strip.Color(255,0, 0), 1);
	}
	colorWipe(strip.Color(0, 255, 0), 1);
}


void loop() 
{
	if (millis() > nextUpdateMS)
	{
		nextUpdateMS = millis() + updateDelayMS;
		getYouTubeStats();
		updateDisplay();
	}
}

void getYouTubeStats()
{
	WiFiClientSecure client;
	
	client.allowSelfSignedCerts();

	Serial.print("connecting to ");
	Serial.println(host);
	if (!client.connect(host, httpsPort)) 
	{
		Serial.println("connection failed");
		return;
	}

	if (!client.verify(fingerprint, host)) 
	{
		Serial.println("certificate doesn't match");
	}


	String url = "/youtube/v3/channels?part=statistics&id=your channel id&key=your api key";
	Serial.print("requesting URL: ");
	Serial.println(url);

	client.print(String("GET ") + url + " HTTP/1.1\r\n" +
		"Host: " + host + "\r\n" +
		"User-Agent: PlayButtonV1\r\n" +
		"Connection: close\r\n\r\n");
	
	while (client.connected()) 
	{
		String line = client.readStringUntil('\n');
		if (line == "\r") 
		{
			break;
		}
	}

	char buffer[750];

	client.readString().toCharArray(buffer, sizeof(buffer));

	parseSubs(buffer);
}

void colorWipe(int c, int wait) 
{
	for (int i = 0; i<strip.numPixels(); i++) 
	{
		strip.setPixelColor(i, c);
		strip.show();
		delay(wait);
	}
}

void whiteStrip()
{
	for (int i = 0; i < NUM_PIXELS; i++)
	{
		strip.setPixelColor(i, strip.Color(255, 255, 255));
		strip.show();
	}	
}

void updateDisplay()
{
	display.clearDisplay();
	display.display();
	printSubs();
	showLogo();
}

void printSubs()
{
	if (curSubs < 1000)	display.setTextSize(6);
	else if (curSubs < 10000) display.setTextSize(5);
	else if (curSubs < 100000) display.setTextSize(4);
	else if (curSubs > 100000) display.setTextSize(3);
	display.setTextColor(WHITE);
	display.setCursor(10, 10);
	display.clearDisplay();
	display.println(curSubs);
	display.display();
	delay(1);

	display.startscrollright(0x00, 0x1F);
	delay(10000);
	display.stopscroll();
}

int parseSubs(char* json)
{
	json = strstr(json, "\"subscriberCount\": \"");
	int newSubs = atoi(json + 20);
	if (newSubs > curSubs) newSubscriber(newSubs);
	curSubs = newSubs;
}

void newSubscriber(int subs)
{
	display.clearDisplay();
	curSubs = subs;

	for (int i = 0; i < 5; i++)
	{
		RGBStripAnim();
	}

	whiteStrip();
	display.clearDisplay();
	PopSubs();
	display.clearDisplay();
}

void PopSubs()
{
	for (int i = 0; i < 6; i++)
	{
		display.setCursor(32, 16);
		display.setTextSize(i);
		display.println(curSubs);
		display.display();
		delay(2000);
		display.clearDisplay();
	}
}

void RGBStripAnim()
{
	colorWipe(strip.Color(255, 0, 0), 25);
	colorWipe(strip.Color(0, 255, 0), 25);
	colorWipe(strip.Color(0, 0, 255), 25);
}
